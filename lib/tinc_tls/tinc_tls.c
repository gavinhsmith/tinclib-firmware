/*
 * BearSSL client pumped over the platform's raw TCP (tinc_tls.h). The
 * ESP8266 links the BearSSL fork bundled with its Arduino core; the PC builds
 * the same fork from external/bearssl, so both behave the same on the wire.
 */
#include <stdio.h>
#include <stdlib.h>
#include <string.h>
#include "tinc_core.h"
#include "tinc_tls.h"
#include "pgmspace.h" /* the SDK's on the ESP8266, BearSSL's shim elsewhere */

#ifdef ESP8266
#include <bearssl/bearssl.h>
#include <StackThunk.h>
/* BearSSL runs its crypto on a separate, bigger stack (the Arduino core's
 * stack thunk), like WiFiClientSecure does. */
unsigned char *thunk_br_ssl_engine_recvapp_buf(const br_ssl_engine_context *cc, size_t *len);
void thunk_br_ssl_engine_recvapp_ack(br_ssl_engine_context *cc, size_t len);
unsigned char *thunk_br_ssl_engine_recvrec_buf(const br_ssl_engine_context *cc, size_t *len);
void thunk_br_ssl_engine_recvrec_ack(br_ssl_engine_context *cc, size_t len);
unsigned char *thunk_br_ssl_engine_sendapp_buf(const br_ssl_engine_context *cc, size_t *len);
void thunk_br_ssl_engine_sendapp_ack(br_ssl_engine_context *cc, size_t len);
unsigned char *thunk_br_ssl_engine_sendrec_buf(const br_ssl_engine_context *cc, size_t *len);
void thunk_br_ssl_engine_sendrec_ack(br_ssl_engine_context *cc, size_t len);
#define br_ssl_engine_recvapp_ack thunk_br_ssl_engine_recvapp_ack
#define br_ssl_engine_recvapp_buf thunk_br_ssl_engine_recvapp_buf
#define br_ssl_engine_recvrec_ack thunk_br_ssl_engine_recvrec_ack
#define br_ssl_engine_recvrec_buf thunk_br_ssl_engine_recvrec_buf
#define br_ssl_engine_sendapp_ack thunk_br_ssl_engine_sendapp_ack
#define br_ssl_engine_sendapp_buf thunk_br_ssl_engine_sendapp_buf
#define br_ssl_engine_sendrec_ack thunk_br_ssl_engine_sendrec_ack
#define br_ssl_engine_sendrec_buf thunk_br_ssl_engine_sendrec_buf
#else
#include <bearssl.h>
#define stack_thunk_add_ref()
#define stack_thunk_del_ref()
#endif

/* CA roots from certs/cacert.pem, in flash (generated by tools/gen_roots.py) */
typedef struct {
    uint8_t hash[32]; /* SHA-256 of the subject DN */
    uint8_t ec, curve;
    uint16_t len1, len2; /* RSA n, e; or the EC point and 0 */
    uint32_t off;        /* into tinc_root_keys */
} tinc_root;
#include "tinc_roots.h"

/* ponytail: always the full 16 KB receive buffer. MFLN could shrink it,
 * but most servers don't support it and probing costs a round trip. */
struct tls_ctx {
    br_ssl_client_context cc;
    br_x509_minimal_context xc;
    unsigned char buf[BR_SSL_BUFSIZE_MONO]; /* half duplex is enough for HTTP/1.1 */
};
#define TLS_HEAP_SPARE 12000u /* ESP8266 stack thunk (~6 KB) + lwIP headroom */

static struct tls_ctx *tls;
static uint8_t tls_fail, tls_detail; /* set once the handshake fails */
static int tls_when;                  /* -1 cert not yet valid, +1 expired */

static br_x509_trust_anchor ta;
static unsigned char ta_dn[32], ta_key[520]; /* RSA-4096 n + e, or a P-521 point */

/* BearSSL asks for the root whose subject DN hashes to hashed_dn. */
static const br_x509_trust_anchor *find_ta(void *ctx, void *hashed_dn, size_t len)
{
    tinc_root r;
    size_t i;

    (void)ctx;
    if (len != sizeof r.hash)
        return NULL;
    /* ponytail: first root with that DN wins; fine while no two Mozilla
     * roots share a subject name (none do today) */
    for (i = 0; i < TINC_ROOT_COUNT; i++) {
        memcpy_P(&r, &tinc_roots[i], sizeof r);
        if (memcmp(r.hash, hashed_dn, sizeof r.hash) || (size_t)r.len1 + r.len2 > sizeof ta_key)
            continue;
        memcpy_P(ta_key, tinc_root_keys + r.off, (size_t)r.len1 + r.len2);
        memcpy(ta_dn, r.hash, sizeof ta_dn);
        memset(&ta, 0, sizeof ta);
        ta.dn.data = ta_dn;
        ta.dn.len = sizeof ta_dn;
        ta.flags = BR_X509_TA_CA;
        if (r.ec) {
            ta.pkey.key_type = BR_KEYTYPE_EC;
            ta.pkey.key.ec.curve = r.curve;
            ta.pkey.key.ec.q = ta_key;
            ta.pkey.key.ec.qlen = r.len1;
        } else {
            ta.pkey.key_type = BR_KEYTYPE_RSA;
            ta.pkey.key.rsa.n = ta_key;
            ta.pkey.key.rsa.nlen = r.len1;
            ta.pkey.key.rsa.e = ta_key + r.len1;
            ta.pkey.key.rsa.elen = r.len2;
        }
        return &ta;
    }
    return NULL;
}

static void free_ta(void *ctx, const br_x509_trust_anchor *t)
{
    (void)ctx;
    (void)t;
}

/* Validity check with our clock, remembering which side a failure was on
 * (BearSSL reports both as BR_ERR_X509_EXPIRED). */
static int check_time(void *ctx, uint32_t nbd, uint32_t nbs, uint32_t nad, uint32_t nas)
{
    uint32_t t = tinc_plat_time(), d = t / 86400 + 719528, s = t % 86400;

    (void)ctx;
    tls_when = (d < nbd || (d == nbd && s < nbs)) ? -1 : (d > nad || (d == nad && s > nas)) ? 1 : 0;
    return tls_when;
}

static void tls_free(void)
{
    if (!tls)
        return;
    free(tls);
    tls = NULL;
    stack_thunk_del_ref();
}

/* BearSSL's error onto the protocol's ERR_TLS / ERR_CERT + TINC_TLSR_*. */
static uint8_t tls_map(int e, uint8_t *d)
{
    if (e > BR_ERR_X509_OK && e < BR_ERR_X509_OK + 32) {
        *d = e == BR_ERR_X509_EXPIRED ? (tls_when < 0 ? TINC_TLSR_NOT_YET_VALID : TINC_TLSR_EXPIRED)
           : e == BR_ERR_X509_BAD_SERVER_NAME ? TINC_TLSR_HOSTNAME
           : e == BR_ERR_X509_NOT_TRUSTED ? TINC_TLSR_UNTRUSTED
           : TINC_TLSR_BAD_CHAIN;
        return TINC_ERR_CERT;
    }
    if (e == BR_ERR_UNSUPPORTED_VERSION || e == BR_ERR_BAD_VERSION ||
        e == BR_ERR_RECV_FATAL_ALERT + 70) /* protocol_version: e.g. a TLS 1.3-only server */
        *d = TINC_TLSR_VERSION;
    else if (e == BR_ERR_BAD_CIPHER_SUITE || e == BR_ERR_RECV_FATAL_ALERT + 40 ||
             e == BR_ERR_RECV_FATAL_ALERT + 71) /* handshake_failure, insufficient_security */
        *d = TINC_TLSR_CIPHER;
    else if (e >= BR_ERR_RECV_FATAL_ALERT && e < BR_ERR_SEND_FATAL_ALERT)
        *d = TINC_TLSR_ALERT;
    else if (e > BR_ERR_OK)
        *d = TINC_TLSR_PROTO;
    else
        *d = TINC_TLSR_OTHER;
    return TINC_ERR_TLS;
}

static void log_err(int e)
{
    char buf[24];

    snprintf(buf, sizeof buf, "tls: error %d", e);
    tinc_plat_log(buf);
}

uint8_t tinc_plat_tls_start(const char *host)
{
    tls_free();
    tls_fail = 0;
    tls_when = 0;
    if (tinc_plat_free_heap() < sizeof *tls + TLS_HEAP_SPARE)
        return TINC_ERR_NO_MEM;
    tls = malloc(sizeof *tls);
    if (!tls)
        return TINC_ERR_NO_MEM;
    stack_thunk_add_ref();
    br_ssl_client_init_full(&tls->cc, &tls->xc, NULL, 0);
    br_x509_minimal_set_dynamic(&tls->xc, NULL, find_ta, free_ta);
    br_x509_minimal_set_time_callback(&tls->xc, NULL, check_time);
    br_ssl_engine_set_buffer(&tls->cc.eng, tls->buf, sizeof tls->buf, 0);
    if (!br_ssl_client_reset(&tls->cc, host, 0)) { /* e.g. no RNG seed */
        log_err(br_ssl_engine_last_error(&tls->cc.eng));
        tls_fail = tls_map(br_ssl_engine_last_error(&tls->cc.eng), &tls_detail);
        tls_free();
    }
    return TINC_OK;
}

uint8_t tinc_plat_tls_err(uint8_t *detail)
{
    *detail = tls_detail;
    return tls_fail;
}

/* One record's worth of engine I/O per call, so a handshake's crypto
 * spreads over several loop iterations and the UART keeps being served.
 * ponytail: a single ECDHE/ECDSA operation can't be split and may take a
 * few hundred ms on an ESP8266 at 80 MHz; it runs at 160 MHz. */
static void tls_step(void)
{
    br_ssl_engine_context *e = &tls->cc.eng;
    unsigned st = br_ssl_engine_current_state(e);
    unsigned char *b;
    size_t len;
    uint16_t n;

    if (st & BR_SSL_SENDREC) {
        b = br_ssl_engine_sendrec_buf(e, &len);
        if ((n = tinc_raw_write(b, len > 0xFFFF ? 0xFFFF : (uint16_t)len)) != 0) {
            br_ssl_engine_sendrec_ack(e, n);
            return;
        }
    }
    if (st & BR_SSL_RECVREC) {
        b = br_ssl_engine_recvrec_buf(e, &len);
        if ((n = tinc_raw_read(b, len > 0xFFFF ? 0xFFFF : (uint16_t)len)) != 0)
            br_ssl_engine_recvrec_ack(e, n);
    }
}

static uint8_t tls_state(void)
{
    unsigned st;
    uint8_t t;
    int e;

    if (tls_fail)
        return TINC_TCP_ERR_TLS;
    tls_step();
    st = br_ssl_engine_current_state(&tls->cc.eng);
    if (st & BR_SSL_CLOSED) {
        e = br_ssl_engine_last_error(&tls->cc.eng);
        if (e == BR_ERR_OK)
            return TINC_TCP_CLOSED; /* close_notify */
        log_err(e);
        tls_fail = tls_map(e, &tls_detail);
        return TINC_TCP_ERR_TLS;
    }
    t = tinc_raw_state();
    if (t == TINC_TCP_CLOSED && (tinc_raw_pending() || (st & BR_SSL_RECVAPP)))
        t = TINC_TCP_OPEN; /* records that arrived before the close still decrypt */
    if (t != TINC_TCP_OPEN)
        return t; /* the core tells a hang-up mid-handshake from one mid-body */
    return (st & (BR_SSL_SENDAPP | BR_SSL_RECVAPP)) ? TINC_TCP_OPEN : TINC_TCP_TLS;
}

static uint16_t tls_write(const uint8_t *p, uint16_t n)
{
    br_ssl_engine_context *e = &tls->cc.eng;
    unsigned char *b;
    size_t len;

    if (tls_fail || !(br_ssl_engine_current_state(e) & BR_SSL_SENDAPP))
        return 0;
    b = br_ssl_engine_sendapp_buf(e, &len);
    if (n > len)
        n = (uint16_t)len;
    memcpy(b, p, n);
    br_ssl_engine_sendapp_ack(e, n);
    br_ssl_engine_flush(e, 0);
    tls_step();
    return n;
}

static uint16_t tls_read(uint8_t *p, uint16_t n)
{
    br_ssl_engine_context *e = &tls->cc.eng;
    unsigned char *b;
    size_t len;

    if (tls_fail)
        return 0;
    if (!(br_ssl_engine_current_state(e) & BR_SSL_RECVAPP))
        tls_step();
    if (!(br_ssl_engine_current_state(e) & BR_SSL_RECVAPP))
        return 0;
    b = br_ssl_engine_recvapp_buf(e, &len);
    if (n > len)
        n = (uint16_t)len;
    memcpy(p, b, n);
    br_ssl_engine_recvapp_ack(e, n);
    return n;
}

/* The core's view: plain TCP, or TLS once tinc_plat_tls_start ran. */
int tinc_plat_tcp_open(const char *host, uint16_t port)
{
    tls_free();
    tls_fail = 0;
    return tinc_raw_open(host, port);
}

void tinc_plat_tcp_close(void)
{
    tls_free();
    tls_fail = 0;
    tinc_raw_close();
}

uint8_t tinc_plat_tcp_state(void)
{
    return tls || tls_fail ? tls_state() : tinc_raw_state();
}

uint16_t tinc_plat_tcp_write(const uint8_t *p, uint16_t n)
{
    return tls ? tls_write(p, n) : tinc_raw_write(p, n);
}

uint16_t tinc_plat_tcp_read(uint8_t *p, uint16_t n)
{
    return tls ? tls_read(p, n) : tinc_raw_read(p, n);
}
